## boards/shields/sebiboard/Kconfig.defconfig
```kconfig
if SHIELD_SEBIBOARD_LEFT

config ZMK_KEYBOARD_NAME
    default "sebiboard"

config ZMK_SPLIT_ROLE_CENTRAL
    default y

endif # SHIELD_SEBIBOARD_LEFT

if SHIELD_SEBIBOARD_LEFT || SHIELD_SEBIBOARD_RIGHT

config ZMK_SPLIT
    default y

endif # SHIELD_SEBIBOARD_LEFT || SHIELD_SEBIBOARD_RIGHT
```

## boards/shields/sebiboard/Kconfig.shield
```kconfig
config SHIELD_SEBIBOARD_LEFT
    def_bool $(shields_list_contains,sebiboard_left)

config SHIELD_SEBIBOARD_RIGHT
    def_bool $(shields_list_contains,sebiboard_right)
```
